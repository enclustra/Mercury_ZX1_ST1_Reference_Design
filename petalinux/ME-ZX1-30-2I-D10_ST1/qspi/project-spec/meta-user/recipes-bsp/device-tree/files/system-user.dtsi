/include/ "system-conf.dtsi"
/ {
	model = "Enclustra ME-ZX1-30-2I-D10 SOM";
};
#include "zynq_enclustra_common.dtsi"
#include "zynq_enclustra_mercury_st1.dtsi"
#include "zynq_enclustra_mercury_zx1.dtsi"
#include "zynq_enclustra_nand_parts.dtsi"
