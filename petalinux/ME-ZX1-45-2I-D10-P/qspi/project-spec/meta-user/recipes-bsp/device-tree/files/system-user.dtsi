/include/ "system-conf.dtsi"
/ {
	model = "Enclustra ME-ZX1-45-2I-D10-P SOM";
};
#include "zynq_enclustra_common.dtsi"
#include "zynq_enclustra_mercury_zx1.dtsi"
#include "zynq_enclustra_mercury_st1.dtsi"
#include "zynq_enclustra_nand_parts.dtsi"
